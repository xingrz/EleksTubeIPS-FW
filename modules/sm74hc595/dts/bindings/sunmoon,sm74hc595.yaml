## modules/sm74hc595/dts/bindings/sunmoon,sm74hc595.yaml
```yaml
description: Sunmoon 74HC595 GPIO controller

compatible: "sunmoon,sm74hc595"

include: base.yaml

properties:
  ser-gpios:
    type: phandle-array
    required: true

  sck-gpios:
    type: phandle-array
    required: true

  rck-gpios:
    type: phandle-array
    required: true

  init-states:
    type: int
```

## modules/st7789v_eleks/dts/bindings/eleks,st7789v.yaml
```yaml
compatible: "eleks,st7789v"

include: ["sitronix,st7789v.yaml"]

properties:
    enable-gpios:
      type: phandle-array
      required: false

    screens:
      type: int
      required: false

    screen-selector:
      type: phandle
      required: false
```
